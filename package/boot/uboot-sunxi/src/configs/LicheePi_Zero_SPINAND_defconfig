## package/boot/uboot-sunxi/src/configs/LicheePi_Zero_SPINAND_defconfig
```kconfig
CONFIG_SPL=y
CONFIG_ARM=y
CONFIG_SYS_CLK_FREQ=1200000000
CONFIG_ARCH_SUNXI=y
CONFIG_MACH_SUN8I_V3S=y
CONFIG_DRAM_CLK=360
CONFIG_DEFAULT_DEVICE_TREE="sun8i-v3s-licheepi-zero-spinand"
CONFIG_SPL_STACK_R_ADDR=0x43e00000
CONFIG_PRE_CON_BUF_ADDR=0x43020000

## USB
CONFIG_USB0_ID_DET="PF6"
CONFIG_PHY_SUN4I_USB=y
# CONFIG_USB_EHCI_HCD=y
# CONFIG_USB_OHCI_HCD=y
CONFIG_USB=y
CONFIG_DM_USB=y
CONFIG_USB_MUSB_HOST=y

## Network
CONFIG_CMD_MDIO=y
CONFIG_PHYLIB=y
CONFIG_PHY_ADDR_ENABLE=y
CONFIG_DM_ETH=y
CONFIG_DM_MDIO=y
CONFIG_DM_MDIO_MUX=y
CONFIG_NETDEVICES=y
CONFIG_MII=y
CONFIG_SUN8I_EMAC=y

## SPI
## These are the standard spi boot handling, which is NOT done, since the custom spinand method is used.
# CONFIG_SPI_BOOT=y
# CONFIG_SPL_SPI_SUPPORT=y
# CONFIG_SPL_SPI_SUNXI=y
##
## NOR
## These are poorly named generic sounding options that are actually for NOR flash only.
# CONFIG_SPI_FLASH=y
# CONFIG_DM_SPI_FLASH=y
# CONFIG_SPI_FLASH_MTD=y
# CONFIG_SF_DEFAULT_SPEED=24000000
# CONFIG_CMD_SF=y
##

CONFIG_SPI=y
CONFIG_SPI_SUNXI=y
CONFIG_SPL_SPINAND_SUNXI=y
# CONFIG_SPL_SPINAND_SUNXI_SPL_USE_GENERIC2K_ON_UNKNOWN=y
CONFIG_DM=y
CONFIG_DM_SPI=y
CONFIG_DM_MTD=y
CONFIG_MTD=y
CONFIG_MTD_SPI_NAND=y
CONFIG_CMD_DM=y
CONFIG_CMD_SPI=y
CONFIG_CMD_MTD=y

## UBI
CONFIG_MTD_UBI=y
CONFIG_MTD_UBI_FASTMAP=y
CONFIG_MTD_UBI_FASTMAP_AUTOCONVERT=1
CONFIG_CMD_UBI=y
CONFIG_CMD_UBIFS=y
CONFIG_RBTREE=y
CONFIG_MTD_DEVICE=y
CONFIG_MTD_PARTITIONS=y
CONFIG_CMD_MTDPARTS=y
CONFIG_LZO=y
CONFIG_LZMA=y

## ENV
CONFIG_ENV_IS_NOWHERE=y
CONFIG_ENV_IS_IN_FAT=n
# CONFIG_ENV_IS_IN_UBI=n
# CONFIG_ENV_UBI_PART="ubi0"
# CONFIG_ENV_UBI_VOLUME="ubootenv"
# CONFIG_ENV_UBI_VOLUME_REDUND="ubootenv2"
## A handy option would be to reset and save the default env: "ubifsload 0x43000000 reset_env && env default -a && saveenv;"
## Although currently there is no custom environment use cases so it always loads the default.
#
## Would be useful to override the boot procedure when needed. Compile a list useful environment variables for special boot procedures.
## Network booting and usb booting would be possible. Good for reflashing in case of failure.
# CONFIG_PREBOOT="usb start && fatload usb 0 0x43000000 uEnv.txt && env import -t ${fileaddr} ${filesize}"
#

## BOOT
CONFIG_MTDIDS_DEFAULT="spi-nand0=0"
CONFIG_MTDPARTS_DEFAULT="mtdparts=0:2M(boot),-(ubi0)"
# CONFIG_MTDPARTS_DEFAULT="mtdparts=0:3M(boot),-(ubi0)"
CONFIG_BOOTCOMMAND="ubifsmount ubi0:kernel; ubifsload $kernel_addr_r uImage; ubifsload $fdt_addr_r dtb; bootm 0x41000000 - 0x41800000"
CONFIG_USE_BOOTARGS=y
CONFIG_BOOTARGS="console=ttyS0,115200 earlyprintk panic=5 rootwait ubi.mtd=1,2048 rootfstype=ubifs root=ubi0:rootfs rw"

## DEBUG
# CONFIG_LOGLEVEL=7
# CONFIG_SHOW_ERRORS=y
# CONFIG_SPL_LOGLEVEL=7
# CONFIG_SPL_SHOW_ERRORS=y
# CONFIG_SPL_USE_TINY_PRINTF=n
# CONFIG_HEXDUMP=y
# CONFIG_SPL_HEXDUMP=y
```

## package/boot/uboot-sunxi/src/configs/LicheePi_Zero_defconfig
```kconfig
CONFIG_SPL=y
CONFIG_ARM=y
CONFIG_SYS_CLK_FREQ=1200000000
CONFIG_ARCH_SUNXI=y
CONFIG_MACH_SUN8I_V3S=y
CONFIG_DRAM_CLK=360
CONFIG_DEFAULT_DEVICE_TREE="sun8i-v3s-licheepi-zero"
CONFIG_SPL_STACK_R_ADDR=0x43e00000
CONFIG_PRE_CON_BUF_ADDR=0x43020000

## USB
CONFIG_USB0_ID_DET="PF6"
CONFIG_PHY_SUN4I_USB=y
#CONFIG_USB_EHCI_HCD=y
#CONFIG_USB_OHCI_HCD=y
CONFIG_USB=y
CONFIG_DM_USB=y
CONFIG_USB_MUSB_HOST=y

## Network
CONFIG_CMD_MDIO=y
CONFIG_PHYLIB=y
CONFIG_PHY_ADDR_ENABLE=y
CONFIG_DM_ETH=y
CONFIG_DM_MDIO=y
CONFIG_DM_MDIO_MUX=y
CONFIG_NETDEVICES=y
CONFIG_MII=y
CONFIG_SUN8I_EMAC=y

## SPI
CONFIG_SPI=y
CONFIG_SPI_SUNXI=y
CONFIG_DM=y
CONFIG_DM_SPI=y
CONFIG_DM_MTD=y
CONFIG_MTD=y
CONFIG_MTD_SPI_NAND=y
CONFIG_CMD_DM=y
CONFIG_CMD_SPI=y
CONFIG_CMD_MTD=y

## UBI
CONFIG_MTD_UBI=y
CONFIG_CMD_UBI=y
CONFIG_CMD_UBIFS=y
CONFIG_RBTREE=y
CONFIG_MTD_DEVICE=y
CONFIG_MTD_PARTITIONS=y
CONFIG_CMD_MTDPARTS=y
CONFIG_LZO=y
CONFIG_LZMA=y

## ENV
CONFIG_PREBOOT="fatload mmc 0:1 0x43000000 uEnv.txt && env import -t ${fileaddr} ${filesize}"

## DEBUG
# CONFIG_LOGLEVEL=7
# CONFIG_SHOW_ERRORS=y
# CONFIG_SPL_LOGLEVEL=7
# CONFIG_SPL_SHOW_ERRORS=y
# CONFIG_SPL_USE_TINY_PRINTF=n
# CONFIG_HEXDUMP=y
# CONFIG_SPL_HEXDUMP=y
```

## target/linux/sunxi/files-5.10/drivers/cryptodev/Kconfig
```kconfig
# SPDX-License-Identifier: GPL-2.0-only
config CRYPTODEV
	tristate "cryptodev"
	select CRYPTO_AUTHENC
	select CRYPTO_HASH
	default n
	help
	  This is the out-of-tree cryptodev driver.
```

## target/linux/sunxi/image/Config.in
```kconfig
if ! TARGET_sunxi_cortexa7v3sspinand

config SUNXI_SD_BOOT_PARTSIZE
	int "Boot (SD Card) filesystem partition size (in MB)"
	depends on TARGET_sunxi
	default 20

endif

if TARGET_sunxi_cortexa7v3sspinand

menuconfig SUN8I_V3S_SPINAND_OPTIONS
	bool "SPI-NAND options"
	default y if TARGET_sunxi_cortexa7v3sspinand

config SUNXI_SPINAND_PAGESIZE
	int "SPI-NAND pagesize size"
	depends on TARGET_sunxi_cortexa7v3sspinand
	depends on SUN8I_V3S_SPINAND_OPTIONS
	default 2048
	range 1024 8192

config SUNXI_SPINAND_BLOCKSIZE
	int "SPI-NAND block-size (in KiB)"
	depends on TARGET_sunxi_cortexa7v3sspinand
	depends on SUN8I_V3S_SPINAND_OPTIONS
	default 128

config SUN8I_V3S_OFFSET_UBI
	int "Offset of ubi in the spi-nand"
	depends on TARGET_sunxi_cortexa7v3sspinand
	depends on SUN8I_V3S_SPINAND_OPTIONS
	default 3145728 if SUNXI_SPINAND_PAGESIZE = 2048 && SUN8I_V3S_SPINAND_DUPLICATE_BOOT && SUN8I_V3S_SPINAND_DUPLICATE_BOOT_UBOOT > 2
	default 2097152 if SUNXI_SPINAND_PAGESIZE = 2048 && SUN8I_V3S_SPINAND_DUPLICATE_BOOT
	default 1048576 if SUNXI_SPINAND_PAGESIZE = 2048
	help 
	  This value must be greater than the total size of the SPL and u-boot copies.
	  When changing be sure to sync the values used in the u-boot board defconfig
	  (CONFIG_MTDPARTS_DEFAULT), and the u-boot device tree spi-nand flash node.

menuconfig SUN8I_V3S_SPINAND_DUPLICATE_BOOT
	bool "Duplicate SPL and u-boot for better fail-safety"
	depends on TARGET_sunxi_cortexa7v3sspinand
	default n
	help
	  Copies the SPL multiple times to the different EGON-entrypoints and PEBs.
	  Also copies u-boot multiple times in case one gets corrputed

if SUN8I_V3S_SPINAND_DUPLICATE_BOOT

config SUN8I_V3S_SPINAND_DUPLICATE_BOOT_SPL
	int "Number of SPLs stored"
	depends on SUN8I_V3S_SPINAND_DUPLICATE_BOOT
	range 1 8
	default 4
	help 
	  eGON.BROM searches for an valid SPL at pages 0, 32, 64, 96, 128, 160, 192 and 224.
	  We can put the SPL multiple times to each of the entry-points and eGON.BROM would load the SPL
	  from page 32 if the SPL on page 0 is corrupted. When changing the default value, don't forget to 
	  change CONFIG_SUN8I_V3S_OFFSET_UBI!

config SUN8I_V3S_SPINAND_DUPLICATE_BOOT_UBOOT
	int "Number of u-boots stored"
	depends on SUN8I_V3S_SPINAND_DUPLICATE_BOOT
	range 1 4
	default 2
	help
	  The SPL is able to load another u-boot if it finds that the first u-boot is corrupted.
	  When changing the default value, don't forget to change CONFIG_SUN8I_V3S_OFFSET_UBI!

endif # SUN8I_V3S_SPINAND_DUPLICATE_BOOT

endif # TARGET_sunxi_cortexa7v3sspinand
```
